/* ISR names for stellaris_fury
 *
 * Version: Sourcery CodeBench 2011.09-82
 * Support: https://support.codesourcery.com/GNUToolchain/
 *
 * Copyright (c) 2007, 2008, 2009, 2010 CodeSourcery, Inc.
 *
 * The authors hereby grant permission to use, copy, modify, distribute,
 * and license this software and its documentation for any purpose, provided
 * that existing copyright notices are retained in all copies and that this
 * notice is included verbatim in any distributions.  No written agreement,
 * license, or royalty fee is required for any of the authorized uses.
 * Modifications to this software may be copyrighted by their authors
 * and need not follow the licensing terms described here, provided that
 * the new terms are clearly indicated on the first page of each file where
 * they apply.
 */
EXTERN (__cs3_stack)
EXTERN (__cs3_reset)
EXTERN (__cs3_isr_nmi)
EXTERN (__cs3_isr_hard_fault)
EXTERN (__cs3_isr_mpu_fault)
EXTERN (__cs3_isr_bus_fault)
EXTERN (__cs3_isr_usage_fault)
EXTERN (__cs3_isr_reserved_7)
EXTERN (__cs3_isr_reserved_8)
EXTERN (__cs3_isr_reserved_9)
EXTERN (__cs3_isr_reserved_10)
EXTERN (__cs3_isr_svcall)
EXTERN (__cs3_isr_debug)
EXTERN (__cs3_isr_reserved_13)
EXTERN (__cs3_isr_pendsv)
EXTERN (__cs3_isr_systick)
EXTERN (__cs3_isr_gpio_a)
EXTERN (__cs3_isr_gpio_b)
EXTERN (__cs3_isr_gpio_c)
EXTERN (__cs3_isr_gpio_d)
EXTERN (__cs3_isr_gpio_e)
EXTERN (__cs3_isr_uart0)
EXTERN (__cs3_isr_uart1)
EXTERN (__cs3_isr_ssi0)
EXTERN (__cs3_isr_i2c0)
EXTERN (__cs3_isr_pwm_fault)
EXTERN (__cs3_isr_pwm0)
EXTERN (__cs3_isr_pwm1)
EXTERN (__cs3_isr_pwm2)
EXTERN (__cs3_isr_qei0)
EXTERN (__cs3_isr_adc0)
EXTERN (__cs3_isr_adc1)
EXTERN (__cs3_isr_adc2)
EXTERN (__cs3_isr_adc3)
EXTERN (__cs3_isr_watchdog)
EXTERN (__cs3_isr_timer0a)
EXTERN (__cs3_isr_timer0b)
EXTERN (__cs3_isr_timer1a)
EXTERN (__cs3_isr_timer1b)
EXTERN (__cs3_isr_timer2a)
EXTERN (__cs3_isr_timer2b)
EXTERN (__cs3_isr_comp0)
EXTERN (__cs3_isr_comp1)
EXTERN (__cs3_isr_comp2)
EXTERN (__cs3_isr_sysctl)
EXTERN (__cs3_isr_flashctl)
EXTERN (__cs3_isr_gpio_f)
EXTERN (__cs3_isr_gpio_g)
EXTERN (__cs3_isr_gpio_h)
EXTERN (__cs3_isr_uart2)
EXTERN (__cs3_isr_ssi1)
EXTERN (__cs3_isr_timer3a)
EXTERN (__cs3_isr_timer3b)
EXTERN (__cs3_isr_i2c1)
EXTERN (__cs3_isr_qei1)
EXTERN (__cs3_isr_can0)
EXTERN (__cs3_isr_can1)
EXTERN (__cs3_isr_can2)
EXTERN (__cs3_isr_ethernet0)
EXTERN (__cs3_isr_hibernate)
