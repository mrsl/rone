const int16 trigMilliRadLookup[] = {
/* idx=0 ang=0 */ 0,
/* idx=1 ang=2 */ 66,
/* idx=2 ang=4 */ 131,
/* idx=3 ang=6 */ 197,
/* idx=4 ang=8 */ 262,
/* idx=5 ang=10 */ 328,
/* idx=6 ang=12 */ 393,
/* idx=7 ang=14 */ 459,
/* idx=8 ang=16 */ 524,
/* idx=9 ang=18 */ 590,
/* idx=10 ang=20 */ 655,
/* idx=11 ang=22 */ 721,
/* idx=12 ang=24 */ 786,
/* idx=13 ang=26 */ 852,
/* idx=14 ang=28 */ 917,
/* idx=15 ang=30 */ 983,
/* idx=16 ang=32 */ 1048,
/* idx=17 ang=34 */ 1114,
/* idx=18 ang=36 */ 1179,
/* idx=19 ang=38 */ 1245,
/* idx=20 ang=40 */ 1310,
/* idx=21 ang=42 */ 1376,
/* idx=22 ang=44 */ 1441,
/* idx=23 ang=46 */ 1507,
/* idx=24 ang=48 */ 1572,
/* idx=25 ang=50 */ 1638,
/* idx=26 ang=52 */ 1703,
/* idx=27 ang=54 */ 1769,
/* idx=28 ang=56 */ 1834,
/* idx=29 ang=58 */ 1899,
/* idx=30 ang=60 */ 1965,
/* idx=31 ang=62 */ 2030,
/* idx=32 ang=64 */ 2096,
/* idx=33 ang=66 */ 2161,
/* idx=34 ang=68 */ 2226,
/* idx=35 ang=70 */ 2292,
/* idx=36 ang=72 */ 2357,
/* idx=37 ang=74 */ 2423,
/* idx=38 ang=76 */ 2488,
/* idx=39 ang=78 */ 2553,
/* idx=40 ang=80 */ 2619,
/* idx=41 ang=82 */ 2684,
/* idx=42 ang=84 */ 2749,
/* idx=43 ang=86 */ 2814,
/* idx=44 ang=88 */ 2880,
/* idx=45 ang=90 */ 2945,
/* idx=46 ang=92 */ 3010,
/* idx=47 ang=94 */ 3076,
/* idx=48 ang=96 */ 3141,
/* idx=49 ang=98 */ 3206,
/* idx=50 ang=100 */ 3271,
/* idx=51 ang=102 */ 3336,
/* idx=52 ang=104 */ 3402,
/* idx=53 ang=106 */ 3467,
/* idx=54 ang=108 */ 3532,
/* idx=55 ang=110 */ 3597,
/* idx=56 ang=112 */ 3662,
/* idx=57 ang=114 */ 3727,
/* idx=58 ang=116 */ 3792,
/* idx=59 ang=118 */ 3858,
/* idx=60 ang=120 */ 3923,
/* idx=61 ang=122 */ 3988,
/* idx=62 ang=124 */ 4053,
/* idx=63 ang=126 */ 4118,
/* idx=64 ang=128 */ 4183,
/* idx=65 ang=130 */ 4248,
/* idx=66 ang=132 */ 4313,
/* idx=67 ang=134 */ 4378,
/* idx=68 ang=136 */ 4443,
/* idx=69 ang=138 */ 4508,
/* idx=70 ang=140 */ 4572,
/* idx=71 ang=142 */ 4637,
/* idx=72 ang=144 */ 4702,
/* idx=73 ang=146 */ 4767,
/* idx=74 ang=148 */ 4832,
/* idx=75 ang=150 */ 4897,
/* idx=76 ang=152 */ 4961,
/* idx=77 ang=154 */ 5026,
/* idx=78 ang=156 */ 5091,
/* idx=79 ang=158 */ 5156,
/* idx=80 ang=160 */ 5220,
/* idx=81 ang=162 */ 5285,
/* idx=82 ang=164 */ 5350,
/* idx=83 ang=166 */ 5414,
/* idx=84 ang=168 */ 5479,
/* idx=85 ang=170 */ 5544,
/* idx=86 ang=172 */ 5608,
/* idx=87 ang=174 */ 5673,
/* idx=88 ang=176 */ 5737,
/* idx=89 ang=178 */ 5802,
/* idx=90 ang=180 */ 5866,
/* idx=91 ang=182 */ 5931,
/* idx=92 ang=184 */ 5995,
/* idx=93 ang=186 */ 6060,
/* idx=94 ang=188 */ 6124,
/* idx=95 ang=190 */ 6188,
/* idx=96 ang=192 */ 6253,
/* idx=97 ang=194 */ 6317,
/* idx=98 ang=196 */ 6381,
/* idx=99 ang=198 */ 6446,
/* idx=100 ang=200 */ 6510,
/* idx=101 ang=202 */ 6574,
/* idx=102 ang=204 */ 6638,
/* idx=103 ang=206 */ 6702,
/* idx=104 ang=208 */ 6766,
/* idx=105 ang=210 */ 6831,
/* idx=106 ang=212 */ 6895,
/* idx=107 ang=214 */ 6959,
/* idx=108 ang=216 */ 7023,
/* idx=109 ang=218 */ 7087,
/* idx=110 ang=220 */ 7151,
/* idx=111 ang=222 */ 7215,
/* idx=112 ang=224 */ 7279,
/* idx=113 ang=226 */ 7342,
/* idx=114 ang=228 */ 7406,
/* idx=115 ang=230 */ 7470,
/* idx=116 ang=232 */ 7534,
/* idx=117 ang=234 */ 7598,
/* idx=118 ang=236 */ 7661,
/* idx=119 ang=238 */ 7725,
/* idx=120 ang=240 */ 7789,
/* idx=121 ang=242 */ 7852,
/* idx=122 ang=244 */ 7916,
/* idx=123 ang=246 */ 7980,
/* idx=124 ang=248 */ 8043,
/* idx=125 ang=250 */ 8107,
/* idx=126 ang=252 */ 8170,
/* idx=127 ang=254 */ 8234,
/* idx=128 ang=256 */ 8297,
/* idx=129 ang=258 */ 8360,
/* idx=130 ang=260 */ 8424,
/* idx=131 ang=262 */ 8487,
/* idx=132 ang=264 */ 8550,
/* idx=133 ang=266 */ 8614,
/* idx=134 ang=268 */ 8677,
/* idx=135 ang=270 */ 8740,
/* idx=136 ang=272 */ 8803,
/* idx=137 ang=274 */ 8866,
/* idx=138 ang=276 */ 8929,
/* idx=139 ang=278 */ 8992,
/* idx=140 ang=280 */ 9055,
/* idx=141 ang=282 */ 9118,
/* idx=142 ang=284 */ 9181,
/* idx=143 ang=286 */ 9244,
/* idx=144 ang=288 */ 9307,
/* idx=145 ang=290 */ 9370,
/* idx=146 ang=292 */ 9433,
/* idx=147 ang=294 */ 9495,
/* idx=148 ang=296 */ 9558,
/* idx=149 ang=298 */ 9621,
/* idx=150 ang=300 */ 9683,
/* idx=151 ang=302 */ 9746,
/* idx=152 ang=304 */ 9808,
/* idx=153 ang=306 */ 9871,
/* idx=154 ang=308 */ 9933,
/* idx=155 ang=310 */ 9996,
/* idx=156 ang=312 */ 10058,
/* idx=157 ang=314 */ 10121,
/* idx=158 ang=316 */ 10183,
/* idx=159 ang=318 */ 10245,
/* idx=160 ang=320 */ 10307,
/* idx=161 ang=322 */ 10370,
/* idx=162 ang=324 */ 10432,
/* idx=163 ang=326 */ 10494,
/* idx=164 ang=328 */ 10556,
/* idx=165 ang=330 */ 10618,
/* idx=166 ang=332 */ 10680,
/* idx=167 ang=334 */ 10742,
/* idx=168 ang=336 */ 10804,
/* idx=169 ang=338 */ 10866,
/* idx=170 ang=340 */ 10927,
/* idx=171 ang=342 */ 10989,
/* idx=172 ang=344 */ 11051,
/* idx=173 ang=346 */ 11113,
/* idx=174 ang=348 */ 11174,
/* idx=175 ang=350 */ 11236,
/* idx=176 ang=352 */ 11297,
/* idx=177 ang=354 */ 11359,
/* idx=178 ang=356 */ 11420,
/* idx=179 ang=358 */ 11482,
/* idx=180 ang=360 */ 11543,
/* idx=181 ang=362 */ 11604,
/* idx=182 ang=364 */ 11666,
/* idx=183 ang=366 */ 11727,
/* idx=184 ang=368 */ 11788,
/* idx=185 ang=370 */ 11849,
/* idx=186 ang=372 */ 11910,
/* idx=187 ang=374 */ 11971,
/* idx=188 ang=376 */ 12032,
/* idx=189 ang=378 */ 12093,
/* idx=190 ang=380 */ 12154,
/* idx=191 ang=382 */ 12215,
/* idx=192 ang=384 */ 12276,
/* idx=193 ang=386 */ 12336,
/* idx=194 ang=388 */ 12397,
/* idx=195 ang=390 */ 12458,
/* idx=196 ang=392 */ 12518,
/* idx=197 ang=394 */ 12579,
/* idx=198 ang=396 */ 12639,
/* idx=199 ang=398 */ 12700,
/* idx=200 ang=400 */ 12760,
/* idx=201 ang=402 */ 12820,
/* idx=202 ang=404 */ 12881,
/* idx=203 ang=406 */ 12941,
/* idx=204 ang=408 */ 13001,
/* idx=205 ang=410 */ 13061,
/* idx=206 ang=412 */ 13121,
/* idx=207 ang=414 */ 13181,
/* idx=208 ang=416 */ 13241,
/* idx=209 ang=418 */ 13301,
/* idx=210 ang=420 */ 13361,
/* idx=211 ang=422 */ 13421,
/* idx=212 ang=424 */ 13481,
/* idx=213 ang=426 */ 13540,
/* idx=214 ang=428 */ 13600,
/* idx=215 ang=430 */ 13660,
/* idx=216 ang=432 */ 13719,
/* idx=217 ang=434 */ 13779,
/* idx=218 ang=436 */ 13838,
/* idx=219 ang=438 */ 13897,
/* idx=220 ang=440 */ 13957,
/* idx=221 ang=442 */ 14016,
/* idx=222 ang=444 */ 14075,
/* idx=223 ang=446 */ 14134,
/* idx=224 ang=448 */ 14193,
/* idx=225 ang=450 */ 14253,
/* idx=226 ang=452 */ 14311,
/* idx=227 ang=454 */ 14370,
/* idx=228 ang=456 */ 14429,
/* idx=229 ang=458 */ 14488,
/* idx=230 ang=460 */ 14547,
/* idx=231 ang=462 */ 14606,
/* idx=232 ang=464 */ 14664,
/* idx=233 ang=466 */ 14723,
/* idx=234 ang=468 */ 14781,
/* idx=235 ang=470 */ 14840,
/* idx=236 ang=472 */ 14898,
/* idx=237 ang=474 */ 14956,
/* idx=238 ang=476 */ 15015,
/* idx=239 ang=478 */ 15073,
/* idx=240 ang=480 */ 15131,
/* idx=241 ang=482 */ 15189,
/* idx=242 ang=484 */ 15247,
/* idx=243 ang=486 */ 15305,
/* idx=244 ang=488 */ 15363,
/* idx=245 ang=490 */ 15421,
/* idx=246 ang=492 */ 15479,
/* idx=247 ang=494 */ 15537,
/* idx=248 ang=496 */ 15594,
/* idx=249 ang=498 */ 15652,
/* idx=250 ang=500 */ 15709,
/* idx=251 ang=502 */ 15767,
/* idx=252 ang=504 */ 15824,
/* idx=253 ang=506 */ 15882,
/* idx=254 ang=508 */ 15939,
/* idx=255 ang=510 */ 15996,
/* idx=256 ang=512 */ 16053,
/* idx=257 ang=514 */ 16110,
/* idx=258 ang=516 */ 16167,
/* idx=259 ang=518 */ 16224,
/* idx=260 ang=520 */ 16281,
/* idx=261 ang=522 */ 16338,
/* idx=262 ang=524 */ 16395,
/* idx=263 ang=526 */ 16452,
/* idx=264 ang=528 */ 16508,
/* idx=265 ang=530 */ 16565,
/* idx=266 ang=532 */ 16621,
/* idx=267 ang=534 */ 16678,
/* idx=268 ang=536 */ 16734,
/* idx=269 ang=538 */ 16790,
/* idx=270 ang=540 */ 16847,
/* idx=271 ang=542 */ 16903,
/* idx=272 ang=544 */ 16959,
/* idx=273 ang=546 */ 17015,
/* idx=274 ang=548 */ 17071,
/* idx=275 ang=550 */ 17127,
/* idx=276 ang=552 */ 17183,
/* idx=277 ang=554 */ 17238,
/* idx=278 ang=556 */ 17294,
/* idx=279 ang=558 */ 17350,
/* idx=280 ang=560 */ 17405,
/* idx=281 ang=562 */ 17461,
/* idx=282 ang=564 */ 17516,
/* idx=283 ang=566 */ 17572,
/* idx=284 ang=568 */ 17627,
/* idx=285 ang=570 */ 17682,
/* idx=286 ang=572 */ 17737,
/* idx=287 ang=574 */ 17792,
/* idx=288 ang=576 */ 17847,
/* idx=289 ang=578 */ 17902,
/* idx=290 ang=580 */ 17957,
/* idx=291 ang=582 */ 18012,
/* idx=292 ang=584 */ 18067,
/* idx=293 ang=586 */ 18121,
/* idx=294 ang=588 */ 18176,
/* idx=295 ang=590 */ 18230,
/* idx=296 ang=592 */ 18285,
/* idx=297 ang=594 */ 18339,
/* idx=298 ang=596 */ 18393,
/* idx=299 ang=598 */ 18448,
/* idx=300 ang=600 */ 18502,
/* idx=301 ang=602 */ 18556,
/* idx=302 ang=604 */ 18610,
/* idx=303 ang=606 */ 18664,
/* idx=304 ang=608 */ 18717,
/* idx=305 ang=610 */ 18771,
/* idx=306 ang=612 */ 18825,
/* idx=307 ang=614 */ 18878,
/* idx=308 ang=616 */ 18932,
/* idx=309 ang=618 */ 18985,
/* idx=310 ang=620 */ 19039,
/* idx=311 ang=622 */ 19092,
/* idx=312 ang=624 */ 19145,
/* idx=313 ang=626 */ 19198,
/* idx=314 ang=628 */ 19252,
/* idx=315 ang=630 */ 19305,
/* idx=316 ang=632 */ 19357,
/* idx=317 ang=634 */ 19410,
/* idx=318 ang=636 */ 19463,
/* idx=319 ang=638 */ 19516,
/* idx=320 ang=640 */ 19568,
/* idx=321 ang=642 */ 19621,
/* idx=322 ang=644 */ 19673,
/* idx=323 ang=646 */ 19726,
/* idx=324 ang=648 */ 19778,
/* idx=325 ang=650 */ 19830,
/* idx=326 ang=652 */ 19882,
/* idx=327 ang=654 */ 19934,
/* idx=328 ang=656 */ 19986,
/* idx=329 ang=658 */ 20038,
/* idx=330 ang=660 */ 20090,
/* idx=331 ang=662 */ 20142,
/* idx=332 ang=664 */ 20193,
/* idx=333 ang=666 */ 20245,
/* idx=334 ang=668 */ 20296,
/* idx=335 ang=670 */ 20348,
/* idx=336 ang=672 */ 20399,
/* idx=337 ang=674 */ 20450,
/* idx=338 ang=676 */ 20502,
/* idx=339 ang=678 */ 20553,
/* idx=340 ang=680 */ 20604,
/* idx=341 ang=682 */ 20655,
/* idx=342 ang=684 */ 20705,
/* idx=343 ang=686 */ 20756,
/* idx=344 ang=688 */ 20807,
/* idx=345 ang=690 */ 20857,
/* idx=346 ang=692 */ 20908,
/* idx=347 ang=694 */ 20958,
/* idx=348 ang=696 */ 21009,
/* idx=349 ang=698 */ 21059,
/* idx=350 ang=700 */ 21109,
/* idx=351 ang=702 */ 21159,
/* idx=352 ang=704 */ 21209,
/* idx=353 ang=706 */ 21259,
/* idx=354 ang=708 */ 21309,
/* idx=355 ang=710 */ 21359,
/* idx=356 ang=712 */ 21408,
/* idx=357 ang=714 */ 21458,
/* idx=358 ang=716 */ 21507,
/* idx=359 ang=718 */ 21557,
/* idx=360 ang=720 */ 21606,
/* idx=361 ang=722 */ 21655,
/* idx=362 ang=724 */ 21704,
/* idx=363 ang=726 */ 21753,
/* idx=364 ang=728 */ 21802,
/* idx=365 ang=730 */ 21851,
/* idx=366 ang=732 */ 21900,
/* idx=367 ang=734 */ 21949,
/* idx=368 ang=736 */ 21997,
/* idx=369 ang=738 */ 22046,
/* idx=370 ang=740 */ 22094,
/* idx=371 ang=742 */ 22143,
/* idx=372 ang=744 */ 22191,
/* idx=373 ang=746 */ 22239,
/* idx=374 ang=748 */ 22287,
/* idx=375 ang=750 */ 22335,
/* idx=376 ang=752 */ 22383,
/* idx=377 ang=754 */ 22431,
/* idx=378 ang=756 */ 22479,
/* idx=379 ang=758 */ 22526,
/* idx=380 ang=760 */ 22574,
/* idx=381 ang=762 */ 22621,
/* idx=382 ang=764 */ 22669,
/* idx=383 ang=766 */ 22716,
/* idx=384 ang=768 */ 22763,
/* idx=385 ang=770 */ 22810,
/* idx=386 ang=772 */ 22857,
/* idx=387 ang=774 */ 22904,
/* idx=388 ang=776 */ 22951,
/* idx=389 ang=778 */ 22998,
/* idx=390 ang=780 */ 23044,
/* idx=391 ang=782 */ 23091,
/* idx=392 ang=784 */ 23137,
/* idx=393 ang=786 */ 23184,
/* idx=394 ang=788 */ 23230,
/* idx=395 ang=790 */ 23276,
/* idx=396 ang=792 */ 23322,
/* idx=397 ang=794 */ 23368,
/* idx=398 ang=796 */ 23414,
/* idx=399 ang=798 */ 23460,
/* idx=400 ang=800 */ 23506,
/* idx=401 ang=802 */ 23551,
/* idx=402 ang=804 */ 23597,
/* idx=403 ang=806 */ 23642,
/* idx=404 ang=808 */ 23687,
/* idx=405 ang=810 */ 23733,
/* idx=406 ang=812 */ 23778,
/* idx=407 ang=814 */ 23823,
/* idx=408 ang=816 */ 23868,
/* idx=409 ang=818 */ 23913,
/* idx=410 ang=820 */ 23957,
/* idx=411 ang=822 */ 24002,
/* idx=412 ang=824 */ 24047,
/* idx=413 ang=826 */ 24091,
/* idx=414 ang=828 */ 24136,
/* idx=415 ang=830 */ 24180,
/* idx=416 ang=832 */ 24224,
/* idx=417 ang=834 */ 24268,
/* idx=418 ang=836 */ 24312,
/* idx=419 ang=838 */ 24356,
/* idx=420 ang=840 */ 24400,
/* idx=421 ang=842 */ 24443,
/* idx=422 ang=844 */ 24487,
/* idx=423 ang=846 */ 24531,
/* idx=424 ang=848 */ 24574,
/* idx=425 ang=850 */ 24617,
/* idx=426 ang=852 */ 24660,
/* idx=427 ang=854 */ 24704,
/* idx=428 ang=856 */ 24747,
/* idx=429 ang=858 */ 24789,
/* idx=430 ang=860 */ 24832,
/* idx=431 ang=862 */ 24875,
/* idx=432 ang=864 */ 24918,
/* idx=433 ang=866 */ 24960,
/* idx=434 ang=868 */ 25002,
/* idx=435 ang=870 */ 25045,
/* idx=436 ang=872 */ 25087,
/* idx=437 ang=874 */ 25129,
/* idx=438 ang=876 */ 25171,
/* idx=439 ang=878 */ 25213,
/* idx=440 ang=880 */ 25255,
/* idx=441 ang=882 */ 25297,
/* idx=442 ang=884 */ 25338,
/* idx=443 ang=886 */ 25380,
/* idx=444 ang=888 */ 25421,
/* idx=445 ang=890 */ 25462,
/* idx=446 ang=892 */ 25504,
/* idx=447 ang=894 */ 25545,
/* idx=448 ang=896 */ 25586,
/* idx=449 ang=898 */ 25626,
/* idx=450 ang=900 */ 25667,
/* idx=451 ang=902 */ 25708,
/* idx=452 ang=904 */ 25749,
/* idx=453 ang=906 */ 25789,
/* idx=454 ang=908 */ 25829,
/* idx=455 ang=910 */ 25870,
/* idx=456 ang=912 */ 25910,
/* idx=457 ang=914 */ 25950,
/* idx=458 ang=916 */ 25990,
/* idx=459 ang=918 */ 26030,
/* idx=460 ang=920 */ 26069,
/* idx=461 ang=922 */ 26109,
/* idx=462 ang=924 */ 26149,
/* idx=463 ang=926 */ 26188,
/* idx=464 ang=928 */ 26227,
/* idx=465 ang=930 */ 26267,
/* idx=466 ang=932 */ 26306,
/* idx=467 ang=934 */ 26345,
/* idx=468 ang=936 */ 26384,
/* idx=469 ang=938 */ 26423,
/* idx=470 ang=940 */ 26461,
/* idx=471 ang=942 */ 26500,
/* idx=472 ang=944 */ 26538,
/* idx=473 ang=946 */ 26577,
/* idx=474 ang=948 */ 26615,
/* idx=475 ang=950 */ 26653,
/* idx=476 ang=952 */ 26691,
/* idx=477 ang=954 */ 26729,
/* idx=478 ang=956 */ 26767,
/* idx=479 ang=958 */ 26805,
/* idx=480 ang=960 */ 26842,
/* idx=481 ang=962 */ 26880,
/* idx=482 ang=964 */ 26917,
/* idx=483 ang=966 */ 26955,
/* idx=484 ang=968 */ 26992,
/* idx=485 ang=970 */ 27029,
/* idx=486 ang=972 */ 27066,
/* idx=487 ang=974 */ 27103,
/* idx=488 ang=976 */ 27140,
/* idx=489 ang=978 */ 27176,
/* idx=490 ang=980 */ 27213,
/* idx=491 ang=982 */ 27249,
/* idx=492 ang=984 */ 27286,
/* idx=493 ang=986 */ 27322,
/* idx=494 ang=988 */ 27358,
/* idx=495 ang=990 */ 27394,
/* idx=496 ang=992 */ 27430,
/* idx=497 ang=994 */ 27466,
/* idx=498 ang=996 */ 27501,
/* idx=499 ang=998 */ 27537,
/* idx=500 ang=1000 */ 27572,
/* idx=501 ang=1002 */ 27608,
/* idx=502 ang=1004 */ 27643,
/* idx=503 ang=1006 */ 27678,
/* idx=504 ang=1008 */ 27713,
/* idx=505 ang=1010 */ 27748,
/* idx=506 ang=1012 */ 27783,
/* idx=507 ang=1014 */ 27818,
/* idx=508 ang=1016 */ 27852,
/* idx=509 ang=1018 */ 27887,
/* idx=510 ang=1020 */ 27921,
/* idx=511 ang=1022 */ 27955,
/* idx=512 ang=1024 */ 27989,
/* idx=513 ang=1026 */ 28023,
/* idx=514 ang=1028 */ 28057,
/* idx=515 ang=1030 */ 28091,
/* idx=516 ang=1032 */ 28125,
/* idx=517 ang=1034 */ 28158,
/* idx=518 ang=1036 */ 28192,
/* idx=519 ang=1038 */ 28225,
/* idx=520 ang=1040 */ 28258,
/* idx=521 ang=1042 */ 28292,
/* idx=522 ang=1044 */ 28325,
/* idx=523 ang=1046 */ 28357,
/* idx=524 ang=1048 */ 28390,
/* idx=525 ang=1050 */ 28423,
/* idx=526 ang=1052 */ 28455,
/* idx=527 ang=1054 */ 28488,
/* idx=528 ang=1056 */ 28520,
/* idx=529 ang=1058 */ 28552,
/* idx=530 ang=1060 */ 28584,
/* idx=531 ang=1062 */ 28616,
/* idx=532 ang=1064 */ 28648,
/* idx=533 ang=1066 */ 28680,
/* idx=534 ang=1068 */ 28712,
/* idx=535 ang=1070 */ 28743,
/* idx=536 ang=1072 */ 28775,
/* idx=537 ang=1074 */ 28806,
/* idx=538 ang=1076 */ 28837,
/* idx=539 ang=1078 */ 28868,
/* idx=540 ang=1080 */ 28899,
/* idx=541 ang=1082 */ 28930,
/* idx=542 ang=1084 */ 28961,
/* idx=543 ang=1086 */ 28991,
/* idx=544 ang=1088 */ 29022,
/* idx=545 ang=1090 */ 29052,
/* idx=546 ang=1092 */ 29082,
/* idx=547 ang=1094 */ 29112,
/* idx=548 ang=1096 */ 29143,
/* idx=549 ang=1098 */ 29172,
/* idx=550 ang=1100 */ 29202,
/* idx=551 ang=1102 */ 29232,
/* idx=552 ang=1104 */ 29261,
/* idx=553 ang=1106 */ 29291,
/* idx=554 ang=1108 */ 29320,
/* idx=555 ang=1110 */ 29349,
/* idx=556 ang=1112 */ 29378,
/* idx=557 ang=1114 */ 29407,
/* idx=558 ang=1116 */ 29436,
/* idx=559 ang=1118 */ 29465,
/* idx=560 ang=1120 */ 29494,
/* idx=561 ang=1122 */ 29522,
/* idx=562 ang=1124 */ 29550,
/* idx=563 ang=1126 */ 29579,
/* idx=564 ang=1128 */ 29607,
/* idx=565 ang=1130 */ 29635,
/* idx=566 ang=1132 */ 29663,
/* idx=567 ang=1134 */ 29691,
/* idx=568 ang=1136 */ 29718,
/* idx=569 ang=1138 */ 29746,
/* idx=570 ang=1140 */ 29773,
/* idx=571 ang=1142 */ 29801,
/* idx=572 ang=1144 */ 29828,
/* idx=573 ang=1146 */ 29855,
/* idx=574 ang=1148 */ 29882,
/* idx=575 ang=1150 */ 29909,
/* idx=576 ang=1152 */ 29935,
/* idx=577 ang=1154 */ 29962,
/* idx=578 ang=1156 */ 29988,
/* idx=579 ang=1158 */ 30015,
/* idx=580 ang=1160 */ 30041,
/* idx=581 ang=1162 */ 30067,
/* idx=582 ang=1164 */ 30093,
/* idx=583 ang=1166 */ 30119,
/* idx=584 ang=1168 */ 30145,
/* idx=585 ang=1170 */ 30170,
/* idx=586 ang=1172 */ 30196,
/* idx=587 ang=1174 */ 30221,
/* idx=588 ang=1176 */ 30246,
/* idx=589 ang=1178 */ 30272,
/* idx=590 ang=1180 */ 30297,
/* idx=591 ang=1182 */ 30321,
/* idx=592 ang=1184 */ 30346,
/* idx=593 ang=1186 */ 30371,
/* idx=594 ang=1188 */ 30395,
/* idx=595 ang=1190 */ 30420,
/* idx=596 ang=1192 */ 30444,
/* idx=597 ang=1194 */ 30468,
/* idx=598 ang=1196 */ 30492,
/* idx=599 ang=1198 */ 30516,
/* idx=600 ang=1200 */ 30540,
/* idx=601 ang=1202 */ 30564,
/* idx=602 ang=1204 */ 30587,
/* idx=603 ang=1206 */ 30611,
/* idx=604 ang=1208 */ 30634,
/* idx=605 ang=1210 */ 30657,
/* idx=606 ang=1212 */ 30680,
/* idx=607 ang=1214 */ 30703,
/* idx=608 ang=1216 */ 30726,
/* idx=609 ang=1218 */ 30749,
/* idx=610 ang=1220 */ 30771,
/* idx=611 ang=1222 */ 30794,
/* idx=612 ang=1224 */ 30816,
/* idx=613 ang=1226 */ 30838,
/* idx=614 ang=1228 */ 30861,
/* idx=615 ang=1230 */ 30883,
/* idx=616 ang=1232 */ 30904,
/* idx=617 ang=1234 */ 30926,
/* idx=618 ang=1236 */ 30948,
/* idx=619 ang=1238 */ 30969,
/* idx=620 ang=1240 */ 30991,
/* idx=621 ang=1242 */ 31012,
/* idx=622 ang=1244 */ 31033,
/* idx=623 ang=1246 */ 31054,
/* idx=624 ang=1248 */ 31075,
/* idx=625 ang=1250 */ 31095,
/* idx=626 ang=1252 */ 31116,
/* idx=627 ang=1254 */ 31136,
/* idx=628 ang=1256 */ 31157,
/* idx=629 ang=1258 */ 31177,
/* idx=630 ang=1260 */ 31197,
/* idx=631 ang=1262 */ 31217,
/* idx=632 ang=1264 */ 31237,
/* idx=633 ang=1266 */ 31257,
/* idx=634 ang=1268 */ 31276,
/* idx=635 ang=1270 */ 31296,
/* idx=636 ang=1272 */ 31315,
/* idx=637 ang=1274 */ 31334,
/* idx=638 ang=1276 */ 31353,
/* idx=639 ang=1278 */ 31372,
/* idx=640 ang=1280 */ 31391,
/* idx=641 ang=1282 */ 31410,
/* idx=642 ang=1284 */ 31429,
/* idx=643 ang=1286 */ 31447,
/* idx=644 ang=1288 */ 31465,
/* idx=645 ang=1290 */ 31484,
/* idx=646 ang=1292 */ 31502,
/* idx=647 ang=1294 */ 31520,
/* idx=648 ang=1296 */ 31538,
/* idx=649 ang=1298 */ 31555,
/* idx=650 ang=1300 */ 31573,
/* idx=651 ang=1302 */ 31590,
/* idx=652 ang=1304 */ 31608,
/* idx=653 ang=1306 */ 31625,
/* idx=654 ang=1308 */ 31642,
/* idx=655 ang=1310 */ 31659,
/* idx=656 ang=1312 */ 31676,
/* idx=657 ang=1314 */ 31693,
/* idx=658 ang=1316 */ 31709,
/* idx=659 ang=1318 */ 31726,
/* idx=660 ang=1320 */ 31742,
/* idx=661 ang=1322 */ 31758,
/* idx=662 ang=1324 */ 31774,
/* idx=663 ang=1326 */ 31790,
/* idx=664 ang=1328 */ 31806,
/* idx=665 ang=1330 */ 31822,
/* idx=666 ang=1332 */ 31837,
/* idx=667 ang=1334 */ 31853,
/* idx=668 ang=1336 */ 31868,
/* idx=669 ang=1338 */ 31883,
/* idx=670 ang=1340 */ 31898,
/* idx=671 ang=1342 */ 31913,
/* idx=672 ang=1344 */ 31928,
/* idx=673 ang=1346 */ 31943,
/* idx=674 ang=1348 */ 31957,
/* idx=675 ang=1350 */ 31972,
/* idx=676 ang=1352 */ 31986,
/* idx=677 ang=1354 */ 32000,
/* idx=678 ang=1356 */ 32014,
/* idx=679 ang=1358 */ 32028,
/* idx=680 ang=1360 */ 32042,
/* idx=681 ang=1362 */ 32055,
/* idx=682 ang=1364 */ 32069,
/* idx=683 ang=1366 */ 32082,
/* idx=684 ang=1368 */ 32096,
/* idx=685 ang=1370 */ 32109,
/* idx=686 ang=1372 */ 32122,
/* idx=687 ang=1374 */ 32135,
/* idx=688 ang=1376 */ 32147,
/* idx=689 ang=1378 */ 32160,
/* idx=690 ang=1380 */ 32172,
/* idx=691 ang=1382 */ 32185,
/* idx=692 ang=1384 */ 32197,
/* idx=693 ang=1386 */ 32209,
/* idx=694 ang=1388 */ 32221,
/* idx=695 ang=1390 */ 32233,
/* idx=696 ang=1392 */ 32245,
/* idx=697 ang=1394 */ 32256,
/* idx=698 ang=1396 */ 32268,
/* idx=699 ang=1398 */ 32279,
/* idx=700 ang=1400 */ 32290,
/* idx=701 ang=1402 */ 32301,
/* idx=702 ang=1404 */ 32312,
/* idx=703 ang=1406 */ 32323,
/* idx=704 ang=1408 */ 32334,
/* idx=705 ang=1410 */ 32344,
/* idx=706 ang=1412 */ 32355,
/* idx=707 ang=1414 */ 32365,
/* idx=708 ang=1416 */ 32375,
/* idx=709 ang=1418 */ 32385,
/* idx=710 ang=1420 */ 32395,
/* idx=711 ang=1422 */ 32405,
/* idx=712 ang=1424 */ 32415,
/* idx=713 ang=1426 */ 32424,
/* idx=714 ang=1428 */ 32433,
/* idx=715 ang=1430 */ 32443,
/* idx=716 ang=1432 */ 32452,
/* idx=717 ang=1434 */ 32461,
/* idx=718 ang=1436 */ 32470,
/* idx=719 ang=1438 */ 32479,
/* idx=720 ang=1440 */ 32487,
/* idx=721 ang=1442 */ 32496,
/* idx=722 ang=1444 */ 32504,
/* idx=723 ang=1446 */ 32512,
/* idx=724 ang=1448 */ 32520,
/* idx=725 ang=1450 */ 32528,
/* idx=726 ang=1452 */ 32536,
/* idx=727 ang=1454 */ 32544,
/* idx=728 ang=1456 */ 32551,
/* idx=729 ang=1458 */ 32559,
/* idx=730 ang=1460 */ 32566,
/* idx=731 ang=1462 */ 32573,
/* idx=732 ang=1464 */ 32580,
/* idx=733 ang=1466 */ 32587,
/* idx=734 ang=1468 */ 32594,
/* idx=735 ang=1470 */ 32601,
/* idx=736 ang=1472 */ 32607,
/* idx=737 ang=1474 */ 32614,
/* idx=738 ang=1476 */ 32620,
/* idx=739 ang=1478 */ 32626,
/* idx=740 ang=1480 */ 32632,
/* idx=741 ang=1482 */ 32638,
/* idx=742 ang=1484 */ 32644,
/* idx=743 ang=1486 */ 32649,
/* idx=744 ang=1488 */ 32655,
/* idx=745 ang=1490 */ 32660,
/* idx=746 ang=1492 */ 32665,
/* idx=747 ang=1494 */ 32670,
/* idx=748 ang=1496 */ 32675,
/* idx=749 ang=1498 */ 32680,
/* idx=750 ang=1500 */ 32685,
/* idx=751 ang=1502 */ 32689,
/* idx=752 ang=1504 */ 32694,
/* idx=753 ang=1506 */ 32698,
/* idx=754 ang=1508 */ 32702,
/* idx=755 ang=1510 */ 32706,
/* idx=756 ang=1512 */ 32710,
/* idx=757 ang=1514 */ 32714,
/* idx=758 ang=1516 */ 32718,
/* idx=759 ang=1518 */ 32721,
/* idx=760 ang=1520 */ 32725,
/* idx=761 ang=1522 */ 32728,
/* idx=762 ang=1524 */ 32731,
/* idx=763 ang=1526 */ 32734,
/* idx=764 ang=1528 */ 32737,
/* idx=765 ang=1530 */ 32740,
/* idx=766 ang=1532 */ 32742,
/* idx=767 ang=1534 */ 32745,
/* idx=768 ang=1536 */ 32747,
/* idx=769 ang=1538 */ 32749,
/* idx=770 ang=1540 */ 32751,
/* idx=771 ang=1542 */ 32753,
/* idx=772 ang=1544 */ 32755,
/* idx=773 ang=1546 */ 32757,
/* idx=774 ang=1548 */ 32758,
/* idx=775 ang=1550 */ 32760,
/* idx=776 ang=1552 */ 32761,
/* idx=777 ang=1554 */ 32762,
/* idx=778 ang=1556 */ 32763,
/* idx=779 ang=1558 */ 32764,
/* idx=780 ang=1560 */ 32765,
/* idx=781 ang=1562 */ 32766,
/* idx=782 ang=1564 */ 32766,
/* idx=783 ang=1566 */ 32767,
/* idx=784 ang=1568 */ 32767,
/* idx=785 ang=1570 */ 32767,
/* idx=786 ang=1572 */ 32767,
};

